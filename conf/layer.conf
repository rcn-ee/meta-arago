## meta-arago-distro/conf/distro/arago.conf
```bitbake
# Name and version of the distribution
DISTRO_NAME = "Arago"
DISTRO_VERSION = "2022.02"
DISTRO_FEED_URI ?= "http://lcpd.itg.ti.com"
BUILD_VARIANT = "${@['prod','rt','systest'][int(d.getVar('ARAGO_RT_ENABLE'))+int(d.getVar('ARAGO_SYSTEST_ENABLE'))*2]}"
TISDK_VERSION ?= "live"
FEEDURIPREFIX ?= "packages/${DISTRO}-dunfell/${TISDK_VERSION}/${BUILD_VARIANT}/"

OPKG_ARGS:remove = "--prefer-arch-to-version"

TI_MIRROR = "http://software-dl.ti.com/processor-sdk-mirror/sources/"
MIRRORS += " \
bzr://.*/.*      ${TI_MIRROR} \n \
cvs://.*/.*      ${TI_MIRROR} \n \
git://.*/.*      ${TI_MIRROR} \n \
gitsm://.*/.*    ${TI_MIRROR} \n \
hg://.*/.*       ${TI_MIRROR} \n \
osc://.*/.*      ${TI_MIRROR} \n \
p4://.*/.*       ${TI_MIRROR} \n \
npm://.*/.*      ${TI_MIRROR} \n \
ftp://.*/.*      ${TI_MIRROR} \n \
https?$://.*/.*  ${TI_MIRROR} \n \
svn://.*/.*      ${TI_MIRROR} \n \
"

# SDK paths and names
SDK_NAME_PREFIX = "arago"
SDK_VERSION = "${DISTRO_VERSION}"
SDK_VENDOR = "-${SDK_NAME_PREFIX}"
SDK_NAME = "${SDK_NAME_PREFIX}-${SDK_VERSION}"
SDKPATHINSTALL = "/opt/${SDK_NAME}"

IMAGE_FSTYPES += "tar.xz.md5sum"

# Extra boot files for WIC images
do_image_wic[depends] += "tisdk-uenv:do_deploy"
IMAGE_BOOT_FILES += "uEnv.txt"

# Mask any broken recipes (currently none)
#BBMASK = ""

TCMODEAPPEND ?= "-${TCMODE}"
TMPDIR .= "${TCMODEAPPEND}"

# Start with default set of distro features
DISTRO_FEATURES = "${DISTRO_FEATURES_DEFAULT} ${DISTRO_FEATURES_LIBC}"

# Remove some unwanted features
DISTRO_FEATURES:remove = "x11"

# Add additional distro features
DISTRO_FEATURES:append = " pam wayland opengl"
#DISTRO_FEATURES:append = " opencl"
DISTRO_FEATURES:append = " opencv"
DISTRO_FEATURES:append = " openmp"

# Normally target distro features will not be applied to native builds:
# Native distro features on this list will use the target feature value
DISTRO_FEATURES_FILTER_NATIVE:append = " opencl opencv openmp"
DISTRO_FEATURES_FILTER_NATIVESDK:append = " opencl opencv openmp"

# Set global runtime providers for major components
ARAGO_SYSVINIT ?= "0"
VIRTUAL-RUNTIME_dev_manager = "${@["udev", "systemd"][bool(d.getVar("ARAGO_SYSVINIT"))]}"
VIRTUAL-RUNTIME_init_manager = "${@["sysvinit", "systemd"][bool(d.getVar("ARAGO_SYSVINIT"))]}"
VIRTUAL-RUNTIME_initscripts = "${@["initscripts", "systemd-compat-units"][bool(d.getVar("ARAGO_SYSVINIT"))]}"
VIRTUAL-RUNTIME_initramfs = "${@["sysvinit-initramfs", "systemd-initramfs"][bool(d.getVar("ARAGO_SYSVINIT"))]}"
VIRTUAL-RUNTIME_login_manager = "busybox shadow"

DISTRO_FEATURES:append = "${@[""," systemd"][bool(d.getVar("ARAGO_SYSVINIT"))]}"

# Distro-specific package configuration
PACKAGECONFIG:append:pn-systemd = " coredump"

# Configure Qt5 flags (GLES is still required for qtdeclarative and qtwebkit)
PACKAGECONFIG_GL:pn-qtbase = "gles2 linuxfb"
PACKAGECONFIG_DISTRO:pn-qtbase = "icu examples accessibility gif gbm kms libinput"
PACKAGECONFIG_FONTS:pn-qtbase = "fontconfig"

# Add gstreamer in package configuration to enable video
PACKAGECONFIG:append:pn-qtmultimedia = " gstreamer"

# Add examples in Qt5 package configurations
PACKAGECONFIG:append:pn-qtcharts = " examples"
#PACKAGECONFIG:append:pn-qtdeclarative = " examples"
PACKAGECONFIG:append:pn-qtlocation = " examples"
PACKAGECONFIG:append:pn-qtmultimedia = " examples"
PACKAGECONFIG:append:pn-qtscript = " examples"
PACKAGECONFIG:append:pn-qtserialport = " examples"
PACKAGECONFIG:append:pn-qtsvg = " examples"
PACKAGECONFIG:append:pn-qtwayland = " examples"
PACKAGECONFIG:append:pn-qtwebengine = " examples"

# Prefer OpenSSL over GnuTLS for curl due to TSU exemptions
PACKAGECONFIG:pn-curl = "${@bb.utils.contains("DISTRO_FEATURES", "ipv6", "ipv6", "", d)} proxy openssl verbose zlib"

PACKAGECONFIG:pn-glmark2 = "drm-gles2 wayland-gles2"

# Enable encryption support in open62541
PACKAGECONFIG:append:pn-open62541 = " encrypt"

# Enable netperf intervals/pacing and histogram
PACKAGECONFIG:append:pn-netperf = " intervals histogram"

# Use OpenGL ES2 for SDL2
PACKAGECONFIG_GL:pn-libsdl2 = "gles2"

# Add KMS/DRM backend support
PACKAGECONFIG:append:pn-libsdl2 = " kmsdrm"

# Enable cryptodev/devcrypto engine in OpenSSL 1.1
PACKAGECONFIG:append:pn-openssl = " cryptodev-linux"

# Enable GST_TRACER logging in gstreamer
PACKAGECONFIG:append:pn-gstreamer1.0 = " tracer-hooks"

# Enable EGL/GLESv2 support
PACKAGECONFIG:append:pn-cairo = " egl glesv2"

# Disable pulseaudio routing in alsa by default
PACKAGECONFIG:remove:pn-alsa-plugins = "pulseaudio"
RDEPENDS:pulseaudio-server:remove = "alsa-plugins-pulseaudio-conf"

# Enable UI and scripting for perf
PERF_FEATURES_ENABLE ?= "perf-scripting perf-tui"

# Do not warn on meta-gnome w/o x11
SKIP_META_GNOME_SANITY_CHECK = "1"

ARAGO_KERNEL_SUFFIX ?= ""

# Set real-time kernel suffix
ARAGO_RT_ENABLE ?= "0"
ARAGO_KERNEL_SUFFIX:append = "${@oe.utils.conditional("ARAGO_RT_ENABLE", "1", "-rt", "", d)}"

# Set systest kernel suffix
ARAGO_SYSTEST_ENABLE ?= "0"
ARAGO_KERNEL_SUFFIX:append = "${@oe.utils.conditional("ARAGO_SYSTEST_ENABLE", "1", "-systest", "", d)}"
IMAGE_FSTYPES:remove = "${@['','ubi ubifs'][d.getVar('ARAGO_SYSTEST_ENABLE') == '1']}"

# Toolchain should be selected by setting TOOLCHAIN_BRAND in local.conf
# Set some sane defaults, in case someone forgets to set them in local.conf
TC_SANE_DEFAULT ?= "arm"
TOOLCHAIN_TYPE ?= "internal"
TOOLCHAIN_TYPE:omapl138 = "internal"
TOOLCHAIN_BRAND ?= "${@[d.getVar('TC_SANE_DEFAULT'),'gcc'][d.getVar('TOOLCHAIN_TYPE') == 'internal']}"

require conf/distro/include/toolchain-${TOOLCHAIN_BRAND}.inc
require conf/distro/include/toolchain-${TOOLCHAIN_TYPE}.inc

# Enable basic stack and buffer overflow protections
#TARGET_CPPFLAGS += "-fstack-protector -D_FORTIFY_SOURCE=1"
#TARGET_CPPFLAGS += "-fstack-protector"

# Inherit "recipe-data" class to populate SRC_URI in manifest
INHERIT += "recipe-data"

# Load default preferences
require conf/distro/include/arago-prefs.inc

# Allow branding on top of Arago Distro and Core TI-SDK
# If ARAGO_BRAND is not set in local.conf, default to core
ARAGO_BRAND ??= "core"

require conf/distro/include/branding-${ARAGO_BRAND}.inc

# Disable polkit's systemd configuration from meta-oe
POLKITAUTH = ""

# Disable meta-virtualization sanity check and warning
SKIP_META_VIRT_SANITY_CHECK = "1"

# Set ENTERPRISE_DISTRO flag to ensure that recipes that have been flagged
# do not attempt to enable features that have potential commercial
# licensing issues.
ENTERPRISE_DISTRO = "1"

# oe-core uses external libav instead of internal libav for gst-ffmpeg. We
# disable by default the codecs in libav that causes issues with shipping an
# Arago based SDK. No need to prevent gst-ffmpeg from being used since we
# disable troublesome software.
LICENSE_FLAGS_ACCEPTED = "commercial_gst-ffmpeg commercial_gstreamer1.0-libav commercial_faad2 non-commercial_netperf"

# Do not package own copy of perl into devkit, rely on host one
ASSUME_PROVIDED += "nativesdk-perl"
```

## meta-arago-distro/conf/distro/include/arago-prefs.inc
```bitbake
# Set preferred Qt5 versions. Different namespace from Qt4, so no conflict
include conf/distro/include/qt5-versions.inc

# Use the latest version of ltp-ddt for kernel versions 3.8+
PREFERRED_PROVIDER_ltp-ddt = "ltp-ddt"

PREFERRED_PROVIDER_virtual/gettext = "gettext"

PREFERRED_PROVIDER_virtual/kernel = "linux-ti-staging${ARAGO_KERNEL_SUFFIX}"

PREFERRED_PROVIDER_jpeg = "libjpeg-turbo"

# Setting PREFERRED_VERSIONS due to selecting a specific version of a library or
# application that does not have a GPLv3 license
PREFERRED_VERSION_crda = "3.18"
PREFERRED_VERSION_obex = "0.34"

PREFERRED_PROVIDER_wpa-supplicant = "wpa-supplicant"
#PREFERRED_PROVIDER_wpa-supplicant:ti33x = "wpa-supplicant-wl18xx"
#PREFERRED_PROVIDER_wpa-supplicant:ti43x = "wpa-supplicant-wl18xx"
#PREFERRED_PROVIDER_wpa-supplicant:omap-a15 = "wpa-supplicant-wl18xx"
```
