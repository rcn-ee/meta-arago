## meta-arago-distro/conf/distro/include/toolchain-gcc.inc
```bitbake
# Select internal gcc toolchain to be built from sources
TCMODE = "default"
TCLIBC = "glibc"

LIBCEXTENSION = "${@['', '-gnu'][(d.getVar('ABIEXTENSION', True) or '') != '']}"

# Match some of the external vars
TOOLCHAIN_SYS := "${TARGET_SYS}"
TOOLCHAIN_PREFIX := "${TARGET_PREFIX}"

bindir_pn-gcc-cross-canadian-${TRANSLATED_TARGET_ARCH} = "${exec_prefix}/bin"
bindir_pn-binutils-cross-canadian-${TRANSLATED_TARGET_ARCH} = "${exec_prefix}/bin"
bindir_pn-gdb-cross-canadian-${TRANSLATED_TARGET_ARCH} = "${exec_prefix}/bin"

PREFERRED_PROVIDER_gcc-cross-canadian-${TRANSLATED_TARGET_ARCH} ?= "gcc-cross-canadian-${TRANSLATED_TARGET_ARCH}"
PREFERRED_PROVIDER_binutils-cross-canadian-${TRANSLATED_TARGET_ARCH} ?= "binutils-cross-canadian-${TRANSLATED_TARGET_ARCH}"
PREFERRED_PROVIDER_gdb-cross-canadian-${TRANSLATED_TARGET_ARCH} = "gdb-cross-canadian-${TRANSLATED_TARGET_ARCH}"

# Set Cross and SDK toolchain preferences
SDKGCCVERSION ?= "6.3%"
SDKBINUVERSION ?= "2.27%"
SDKGLIBCVERSION ?= "2.25%"
SDKLINUXLIBCVERSION ?= "4.9%"

PREFERRED_VERSION_gcc-crosssdk ?= "${SDKGCCVERSION}"
PREFERRED_VERSION_gcc-crosssdk-initial ?= "${SDKGCCVERSION}"
PREFERRED_VERSION_gcc-crosssdk-intermediate ?= "${SDKGCCVERSION}"
PREFERRED_VERSION_nativesdk-gcc-runtime ?= "${SDKGCCVERSION}"
PREFERRED_VERSION_nativesdk-libgcc ?= "${SDKGCCVERSION}"
PREFERRED_VERSION_binutils-crosssdk ?= "${SDKBINUVERSION}"
PREFERRED_VERSION_nativesdk-linux-libc-headers ?= "${SDKLINUXLIBCVERSION}"
PREFERRED_VERSION_nativesdk-glibc ?= "${SDKGLIBCVERSION}"
PREFERRED_VERSION_nativesdk-glibc-initial ?= "${SDKGLIBCVERSION}"

# Set target toolchain preferences to match Cross/SDK by default
# Can be overwritten globally, if needed
GCCVERSION ?= "6.3%"
BINUVERSION ?= "2.27%"
GLIBCVERSION ?= "2.25%"
GLIBCINITVERSION ?= "2.25%"
LINUXLIBCVERSION ?= "4.9%"

PREFERRED_VERSION_gcc ?= "${GCCVERSION}"
PREFERRED_VERSION_binutils ?= "${BINUVERSION}"
PREFERRED_VERSION_linux-libc-headers ?= "${LINUXLIBCVERSION}"
PREFERRED_VERSION_glibc ?= "${GLIBCVERSION}"
PREFERRED_VERSION_glibc-locale ?= "${GLIBCVERSION}"
PREFERRED_VERSION_glibc-initial ?= "${GLIBCINITVERSION}"
```

## meta-arago-distro/conf/distro/include/toolchain-linaro.inc
```bitbake
# Select external binary prebuilt Linaro toolchain
TCMODE = "external-linaro"
TCLIBC = "external-linaro-toolchain"

ELT_TARGET_SYS = "arm-linux-gnueabihf"
TARGET_VENDOR = ""

PREFERRED_PROVIDER_virtual/${TARGET_PREFIX}gcc-intermediate = "external-linaro-toolchain"

# Set some vars to help locate the toolchain automatically from PATH
TOOLCHAIN_SYS := "${ELT_TARGET_SYS}"
TOOLCHAIN_PREFIX := "${TOOLCHAIN_SYS}-"

# Use specific libc headers instead of ones provided by toolchain
PREFERRED_PROVIDER_linux-libc-headers_forcevariable = "linux-libc-headers"
PREFERRED_PROVIDER_linux-libc-headers-dev_forcevariable = "linux-libc-headers"
PREFERRED_PROVIDER_virtual/linux-libc-headers_forcevariable = "linux-libc-headers"

PREFERRED_PROVIDER_gcc-cross-canadian-${TRANSLATED_TARGET_ARCH} ?= "external-linaro-sdk-toolchain"
PREFERRED_PROVIDER_binutils-cross-canadian-${TRANSLATED_TARGET_ARCH} ?= "external-linaro-sdk-toolchain"
#PREFERRED_PROVIDER_gdb-cross-canadian-${TRANSLATED_TARGET_ARCH} = "external-linaro-sdk-toolchain"

# Special case for gdb to be built as part of canadian-cross-sdk, instead of packaged from external toolchain
bindir_pn-gdb-cross-canadian-${TRANSLATED_TARGET_ARCH} = "${exec_prefix}/bin"
PREFERRED_PROVIDER_gdb-cross-canadian-${TRANSLATED_TARGET_ARCH} = "gdb-cross-canadian-${TRANSLATED_TARGET_ARCH}"

# Set up runtime preferences
PREFERRED_PROVIDER_libgcc = "external-linaro-toolchain"
PREFERRED_PROVIDER_gcc-runtime = "external-linaro-toolchain"

# Set Cross and SDK toolchain preferences
SDKGCCVERSION ?= "linaro-6.2%"
SDKBINUVERSION ?= "linaro-2.27%"
SDKGLIBCVERSION ?= "2.24%"
SDKLINUXLIBCVERSION ?= "4.4%"

PREFERRED_VERSION_gcc-crosssdk-${SDK_SYS} ?= "${SDKGCCVERSION}"
PREFERRED_VERSION_gcc-crosssdk-initial-${SDK_SYS} ?= "${SDKGCCVERSION}"
PREFERRED_VERSION_binutils-crosssdk-${SDK_SYS} ?= "${SDKBINUVERSION}"

PREFERRED_VERSION_nativesdk-gcc-runtime ?= "${SDKGCCVERSION}"
PREFERRED_VERSION_nativesdk-libgcc ?= "${SDKGCCVERSION}"
PREFERRED_VERSION_nativesdk-libgcc-initial ?= "${SDKGCCVERSION}"
PREFERRED_VERSION_nativesdk-linux-libc-headers ?= "${SDKLINUXLIBCVERSION}"
PREFERRED_VERSION_nativesdk-glibc ?= "${SDKGLIBCVERSION}"
PREFERRED_VERSION_nativesdk-glibc-initial ?= "${SDKGLIBCVERSION}"

# Set target toolchain preferences to match Cross/SDK by default
# Can be overwritten globally, if needed
GCCVERSION ?= "linaro-6.2%"
BINUVERSION ?= "linaro-2.27%"
GLIBCVERSION ?= "2.24%"
GLIBCINITVERSION ?= "2.24%"
LINUXLIBCVERSION ?= "4.4"

PREFERRED_VERSION_gcc ?= "${GCCVERSION}"
PREFERRED_VERSION_binutils ?= "${BINUVERSION}"
PREFERRED_VERSION_linux-libc-headers ?= "${LINUXLIBCVERSION}"
PREFERRED_VERSION_glibc ?= "${GLIBCVERSION}"
PREFERRED_VERSION_glibc-locale ?= "${GLIBCVERSION}"
PREFERRED_VERSION_glibc-initial ?= "${GLIBCINITVERSION}"
```

## meta-arago-distro/conf/layer.conf
```bitbake
# We have a conf and classes directory, append to BBPATH
BBPATH .= ":${LAYERDIR}"

# We have a recipes directory, add to BBFILES
BBFILES += "${LAYERDIR}/recipes*/*/*.bb ${LAYERDIR}/recipes*/*/*.bbappend"

BBFILE_COLLECTIONS += "meta-arago-distro"
BBFILE_PATTERN_meta-arago-distro := "^${LAYERDIR}/"
BBFILE_PRIORITY_meta-arago-distro = "10"

LAYERSERIES_COMPAT_meta-arago-distro = "kirkstone"

LAYERDEPENDS_meta-arago-distro = " \
    core \
    meta-ti-bsp \
    meta-ti-extras \
    openembedded-layer \
    networking-layer \
    meta-python \
    qt5-layer \
    meta-arago-extras \
"

LAYERRECOMMENDS_meta-arago-distro = " \
    browser-layer \
"

BBFILES_DYNAMIC += " \
    browser-layer:${LAYERDIR}/dynamic-layers/browser-layer/recipes*/*/*.bbappend \
"

BB_DANGLINGAPPENDS_WARNONLY = "true"

SIGGEN_EXCLUDE_SAFE_RECIPE_DEPS += " \
    weston-init->weston \
    weston-init->kbd \
"

SIGGEN_EXCLUDERECIPES_ABISAFE += " \
    udev \
    eudev \
    weston-conf \
    qtbase-conf \
    cryptodev-module \
"

HOSTTOOLS_NONFATAL += "corkscrew getent socket"
```

## meta-arago-distro/conf/machine/arago-armv5.conf
```bitbake
#@TYPE: Machine
#@NAME: Arago unified/fake machine
#@DESCRIPTION: Unified/fake Arago machine configuration for TI/Arago ARMv5 platforms
TARGET_ARCH = "arm"

include conf/machine/include/tune-arm926ejs.inc

IMAGE_FSTYPES = "tar.gz"

SERIAL_CONSOLE = ""
SERIAL_CONSOLES = "115200;ttyS0 115200;ttyS1 115200;ttyS2 115200;ttyO0 115200;ttyO1 115200;ttyO2"
SERIAL_CONSOLES_CHECK = "${SERIAL_CONSOLES}"

PREFERRED_PROVIDER_virtual/kernel ?= "linux-arago"

MACHINE_FEATURES = "kernel26 apm usbgadget usbhost vfat ext2 screen touchscreen"
```

## meta-arago-distro/conf/machine/arago-armv7.conf
```bitbake
#@TYPE: Machine
#@NAME: Arago unified/fake machine
#@DESCRIPTION: Unified/fake Arago machine configuration for TI/Arago ARMv7 platforms
TARGET_ARCH = "arm"

include conf/machine/include/tune-cortexa8.inc

IMAGE_FSTYPES = "tar.gz"

SERIAL_CONSOLE = ""

PREFERRED_PROVIDER_virtual/kernel ?= "linux-arago"

MACHINE_FEATURES = "kernel26 apm usbgadget usbhost vfat ext2 screen touchscreen"
```
