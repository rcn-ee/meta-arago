## conf/layer.conf
```bitbake
# We have a conf and classes directory, append to BBPATH
BBPATH .= ":${LAYERDIR}"

# We have a recipes directory, add to BBFILES
BBFILES += "${LAYERDIR}/recipes*/*/*.bb ${LAYERDIR}/recipes*/*/*.bbappend"

BBFILE_COLLECTIONS += "meta-arago"
BBFILE_PATTERN_meta-arago := "^${LAYERDIR}/"
BBFILE_PRIORITY_meta-arago = "10"
```

## meta-arago-demos/conf/layer.conf
```bitbake
# We have a conf and classes directory, append to BBPATH
BBPATH .= ":${LAYERDIR}"

# We have a recipes directory, add to BBFILES
BBFILES += "${LAYERDIR}/recipes*/*/*.bb ${LAYERDIR}/recipes*/*/*.bbappend"

BBFILE_COLLECTIONS += "meta-arago-demos"
BBFILE_PATTERN_meta-arago-demos := "^${LAYERDIR}/"
BBFILE_PRIORITY_meta-arago-demos = "10"

LAYERSERIES_COMPAT_meta-arago-demos = "kirkstone langdale mickledore"

LAYERDEPENDS_meta-arago-demos = " \
    core \
    meta-ti-bsp \
    meta-ti-extras \
    openembedded-layer \
    networking-layer \
    meta-python \
    arm-toolchain \
    qt5-layer \
"

SIGGEN_EXCLUDE_SAFE_RECIPE_DEPS += " \
    matrix-gui-multimedia-demos->amsdk-av-files \
    matrix-gui-oprofile-demos->oprofile \
    matrix-gui-oprofile-demos->oprofile-example \
    matrix-gui-usb-demos->bonnie++ \
    matrix-gui-armbenchmarks-demos->arm-benchmarks \
    matrix-gui-armbenchmarks-demos->lmbench \
    matrix-gui-armbenchmarks-demos->nbench-byte \
    matrix-gui-machinevision-demos->point-cloud-viewer \
    matrix-lighttpd-config->lighttpd \
"

SIGGEN_EXCLUDERECIPES_ABISAFE += " \
    gstreamer1.0-plugins-bad \
"
```

## meta-arago-distro/conf/distro/arago-source-ipk.conf
```bitbake
#===============================================================================
# BOM Configuration file
#
# Syntax:
#   Select one of available providers (recipes) for a package.
#   Usually used for virtual/xyz style packages. i.e virtual/kernel
#       PREFERRED_PROVIDER_<pkg> = "recipe"
#       PREFERRED_PROVIDER_<pkg>_<mach> = "recipe"
#   i.e.
#       PREFERRED_PROVIDER_virtual/kernel = "linux-davinci"
#       PREFERRED_PROVIDER_virtual/kenrel_omap3evm = "linux-omap3"
#
#   Select one of the available versions for a package
#       PREFERRED_VERSION_<pkg> = "X.Y.Z"
#       PREFERRED_VERSION_<pkg>_<mach> = "X.Y.Z"
#   i.e.
#       PREFERRED_VERSION_udev = "141"
#       PREFERRED_VERSION_udev_omap3evm = "124"
#
#   Enable source ipk creation for a package
#       CREATE_SRCIPK_pn-<pkg> = "1"
#   i.e.
#       CREATE_SRCIPK_pn-u-boot = "1"
#
#   Change install diretory of source ipk for a package
#       SRCIPK_INSTALL_DIR_pn-<pkg> = "<install dir>"
#   i.e.
#       SRCIPK_INSTALL_DIR_pn-u-boot = "board-support/u-boot-source"
#
#   Change source ipk architecture for a package
#       SRCIPK_PACKAGE_ARCH_pn-<pkg> = "<arch>"
#   i.e.
#       SRCIPK_PACKAGE_ARCH_pn-u-boot = "${MACHINE_ARCH}"
#===============================================================================

# Enable the creation of source ipks
INHERIT += "sourceipk"

# Disable including README and recipe files in sourceipks for SDK builds.
SRCIPK_INCLUDE_EXTRAFILES = "0"

# Set source ipk packages and install directories
CREATE_SRCIPK_pn-ti-tisdk-licenses = "1"
SRCIPK_INSTALL_DIR_pn-ti-tisdk-licenses = "docs/licenses"

CREATE_SRCIPK_pn-matrix-gui = "1"
SRCIPK_INSTALL_DIR_pn-matrix-gui = "example-applications/${PN}-${PV}"

CREATE_SRCIPK_pn-ti-crypto-examples = "1"
SRCIPK_INSTALL_DIR_pn-ti-crypto-examples = "example-applications/${PN}-${PV}"

CREATE_SRCIPK_pn-qml-carinfo = "1"
SRCIPK_INSTALL_DIR_pn-qml-carinfo = "example-applications/${PN}-${PV}"

CREATE_SRCIPK_pn-quick-playground = "1"
SRCIPK_INSTALL_DIR_pn-quick-playground = "example-applications/${PN}-${PV}"

CREATE_SRCIPK_pn-qt-catalog = "1"
SRCIPK_INSTALL_DIR_pn-qt-catalog = "example-applications/${PN}-${PV}"

CREATE_SRCIPK_pn-qt-patientcare = "1"
SRCIPK_INSTALL_DIR_pn-qt-patientcare = "example-applications/${PN}-${PV}"

CREATE_SRCIPK_pn-qt-tstat = "1"
SRCIPK_INSTALL_DIR_pn-qt-tstat = "example-applications/${PN}-${PV}"

CREATE_SRCIPK_pn-matrix-gui-browser = "1"
SRCIPK_INSTALL_DIR_pn-matrix-gui-browser = "example-applications/${PN}-${PV}"

CREATE_SRCIPK_pn-refresh-screen = "1"
SRCIPK_INSTALL_DIR_pn-refresh-screen = "example-applications/${PN}-${PV}"

CREATE_SRCIPK_pn-am-sysinfo = "1"
SRCIPK_INSTALL_DIR_pn-am-sysinfo = "example-applications/${PN}-${PV}"

CREATE_SRCIPK_pn-arm-benchmarks = "1"
SRCIPK_INSTALL_DIR_pn-arm-benchmarks = "example-applications/${PN}-${PV}"

CREATE_SRCIPK_pn-ti-pru-sw-examples = "1"
SRCIPK_INSTALL_DIR_pn-ti-pru-sw-examples = "example-applications/pru-${PV}"

CREATE_SRCIPK_pn-ti-ocf-crypto-module = "1"
SRCIPK_INSTALL_DIR_pn-ti-ocf-crypto-module = "board-support/extra-drivers/${PN}-${PV}"

CREATE_SRCIPK_pn-bt-enable = "1"
SRCIPK_INSTALL_DIR_pn-bt-enable = "board-support/extra-drivers/${PN}-${PV}"

CREATE_SRCIPK_pn-bt-firmware = "1"
SRCIPK_INSTALL_DIR_pn-bt-firmware = "board-support/extra-drivers/${PN}-${PV}"

CREATE_SRCIPK_pn-ti-compat-wireless-wl12xx = "1"
SRCIPK_INSTALL_DIR_pn-ti-compat-wireless-wl12xx = "board-support/extra-drivers/${PN}-${PV}"

CREATE_SRCIPK_pn-ti-compat-bluetooth = "1"
SRCIPK_INSTALL_DIR_pn-ti-compat-bluetooth = "board-support/extra-drivers/${PN}-${PV}"

CREATE_SRCIPK_pn-wl1271-wlan-cli = "1"
SRCIPK_INSTALL_DIR_pn-wl1271-wlan-cli = "example-applications/wlan"

CREATE_SRCIPK_pn-av-examples = "1"
SRCIPK_INSTALL_DIR_pn-av-examples = "example-applications/av-examples-${PV}"

CREATE_SRCIPK_pn-u-boot = "1"
SRCIPK_INSTALL_DIR_pn-u-boot = "board-support/u-boot-${UVER}-psp${PSPREL}"
# For beagleboard we use the git version which doesn't define UVER
SRCIPK_INSTALL_DIR_pn-u-boot_beagleboard = "board-support/${P}"
SRCIPK_PACKAGE_ARCH_pn-u-boot = "${MACHINE_ARCH}"

CREATE_SRCIPK_pn-x-load = "1"
SRCIPK_INSTALL_DIR_pn-x-load = "board-support/x-load-${XVER}-psp${PSPREL}"
# For beagleboard we use the git version which doesn't define XVER
SRCIPK_INSTALL_DIR_pn-x-load_beagleboard = "board-support/${P}"
SRCIPK_PACKAGE_ARCH_pn-x-load = "${MACHINE_ARCH}"

CREATE_SRCIPK_pn-u-boot-ti-staging = "1"
SRCIPK_INSTALL_DIR_pn-u-boot-ti-staging = "board-support/u-boot-${PV}-${PR}"
SRCIPK_PACKAGE_ARCH_pn-u-boot-ti-staging = "${MACHINE_ARCH}"

CREATE_SRCIPK_pn-linux-ti-staging = "1"
SRCIPK_INSTALL_DIR_pn-linux-ti-staging = "board-support/linux-${PV}"
SRCIPK_PACKAGE_ARCH_pn-linux-ti-staging = "${MACHINE_ARCH}"

CREATE_SRCIPK_pn-linux-omapl138-psp = "1"
SRCIPK_INSTALL_DIR_pn-linux-omapl138-psp = "board-support/linux-${KVER}-psp${PSPREL}"
SRCIPK_PACKAGE_ARCH_pn-linux-omapl138-psp = "${MACHINE_ARCH}"

CREATE_SRCIPK_pn-linux-omap-psp = "1"
SRCIPK_INSTALL_DIR_pn-linux-omap-psp = "board-support/linux-${KVER}-psp${PSPREL}"
SRCIPK_PACKAGE_ARCH_pn-linux-omap-psp = "${MACHINE_ARCH}"

CREATE_SRCIPK_pn-linux-am335x = "1"
SRCIPK_INSTALL_DIR_pn-linux-am335x = "board-support/linux-${KVER}"
SRCIPK_PACKAGE_ARCH_pn-linux-am335x = "${MACHINE_ARCH}"

CREATE_SRCIPK_pn-linux-omap = "1"
SRCIPK_INSTALL_DIR_pn-linux-omap = "board-support/linux-${PV}-${PR}"
SRCIPK_PACKAGE_ARCH_pn-linux-omap = "${MACHINE_ARCH}"

CREATE_SRCIPK_pn-linux = "1"
SRCIPK_INSTALL_DIR_pn-linux = "board-support/linux-${PV}"
SRCIPK_PACKAGE_ARCH_pn-linux = "${MACHINE_ARCH}"

CREATE_SRCIPK_pn-linux-omap4 = "1"
SRCIPK_INSTALL_DIR_pn-linux-omap4 = "board-support/linux-${PV}"
SRCIPK_PACKAGE_ARCH_pn-linux-omap4 = "${MACHINE_ARCH}"

CREATE_SRCIPK_pn-linux-davinci = "1"
SRCIPK_INSTALL_DIR_pn-linux-davinci = "board-support/linux-${KVER}-psp${PSPREL}"
SRCIPK_PACKAGE_ARCH_pn-linux-davinci = "${MACHINE_ARCH}"

CREATE_SRCIPK_pn-linux-omapl1 = "1"
SRCIPK_INSTALL_DIR_pn-linux-omapl1 = "board-support/linux-${KVER}-psp${PSPREL}"
SRCIPK_PACKAGE_ARCH_pn-linux-omapl1 = "${MACHINE_ARCH}"

CREATE_SRCIPK_pn-ti-linux-driver-examples = "1"
SRCIPK_INSTALL_DIR_pn-ti-linux-driver-examples = "example-applications/linux-driver-examples-${PV}"

CREATE_SRCIPK_pn-ti-linux-driver-examples-omapl = "1"
SRCIPK_INSTALL_DIR_pn-ti-linux-driver-examples-omapl = "example-applications/linux-driver-examples-${PV}"

CREATE_SRCIPK_pn-ti-linux-driver-examples-omap3 = "1"
SRCIPK_INSTALL_DIR_pn-ti-linux-driver-examples-omap3 = "example-applications/linux-driver-examples-${PV}"

CREATE_SRCIPK_pn-ti-framework-components = "1"
SRCIPK_INSTALL_DIR_pn-ti-framework-components = "component-sources/framework_components_${PV}${PVExtra}"
SRCIPK_PACKAGE_ARCH_pn-ti-framework-components = "${MACHINE_ARCH}"

CREATE_SRCIPK_pn-ti-codec-engine = "1"
SRCIPK_INSTALL_DIR_pn-ti-codec-engine = "component-sources/codec_engine_${PV}${PVExtra}"
SRCIPK_PACKAGE_ARCH_pn-ti-codec-engine = "${MACHINE_ARCH}"

CREATE_SRCIPK_pn-ti-codecs-omap3530 = "1"
SRCIPK_INSTALL_DIR_pn-ti-codecs-omap3530 = "codecs-omap3530_${PV}"
SRCIPK_PACKAGE_ARCH_pn-ti-codecs-omap3530 = "${MACHINE_ARCH}"

CREATE_SRCIPK_pn-ti-linuxutils = "1"
SRCIPK_INSTALL_DIR_pn-ti-linuxutils = "component-sources/linuxutils_${PV}${PVExtra}"
SRCIPK_PACKAGE_ARCH_pn-ti-linuxutils = "${MACHINE_ARCH}"

CREATE_SRCIPK_pn-ti-xdctools = "1"
SRCIPK_INSTALL_DIR_pn-ti-xdctools = "component-sources/xdctools_${PV}"
SRCIPK_PACKAGE_ARCH_pn-ti-xdctools = "${MACHINE_ARCH}"

CREATE_SRCIPK_pn-ti-dmai = "1"
SRCIPK_INSTALL_DIR_pn-ti-dmai = "dmai_${PV}"
SRCIPK_PACKAGE_ARCH_pn-ti-dmai = "${MACHINE_ARCH}"

CREATE_SRCIPK_pn-ti-xdais = "1"
SRCIPK_INSTALL_DIR_pn-ti-xdais = "component-sources/xdais_${PV}${PVExtra}"
SRCIPK_PACKAGE_ARCH_pn-ti-xdais = "${MACHINE_ARCH}"

CREATE_SRCIPK_pn-ti-local-power-manager = "1"
SRCIPK_INSTALL_DIR_pn-ti-local-power-manager = "local-power-manager_${PV}"
SRCIPK_PACKAGE_ARCH_pn-ti-local-power-manager = "${MACHINE_ARCH}"

CREATE_SRCIPK_pn-ti-codecs-dm355 = "1"
SRCIPK_INSTALL_DIR_pn-ti-codecs-dm355 = "codecs-dm355_${PV}"
SRCIPK_PACKAGE_ARCH_pn-ti-codecs-dm355 = "${MACHINE_ARCH}"

CREATE_SRCIPK_pn-ti-dvsdk-demos = "1"
SRCIPK_INSTALL_DIR_pn-ti-dvsdk-demos = "dvsdk-demos_${PV}"
SRCIPK_PACKAGE_ARCH_pn-ti-dvsdk-demos = "${MACHINE_ARCH}"

CREATE_SRCIPK_pn-ti-dvtb = "1"
SRCIPK_INSTALL_DIR_pn-ti-dvtb = "dvtb_${PV}"
SRCIPK_PACKAGE_ARCH_pn-ti-dvtb = "${MACHINE_ARCH}"

CREATE_SRCIPK_pn-ti-codecs-dm365 = "1"
SRCIPK_INSTALL_DIR_pn-ti-codecs-dm365 = "codecs-dm365_${PV}"
SRCIPK_PACKAGE_ARCH_pn-ti-codecs-dm365 = "${MACHINE_ARCH}"

CREATE_SRCIPK_pn-ti-dm365mm-module = "1"
SRCIPK_INSTALL_DIR_pn-ti-dm365mm-module = "dm365mm-module_${PV}"
SRCIPK_PACKAGE_ARCH_pn-ti-dm365mm-module = "${MACHINE_ARCH}"

CREATE_SRCIPK_pn-ti-codecs-dm6446 = "1"
SRCIPK_INSTALL_DIR_pn-ti-codecs-dm6446 = "codecs-dm6446_${PV}"
SRCIPK_PACKAGE_ARCH_pn-ti-codecs-dm6446 = "${MACHINE_ARCH}"

CREATE_SRCIPK_pn-ti-codecs-dm6467 = "1"
SRCIPK_INSTALL_DIR_pn-ti-codecs-dm6467 = "codecs-dm6467_${PV}"
SRCIPK_PACKAGE_ARCH_pn-ti-codecs-dm6467 = "${MACHINE_ARCH}"

CREATE_SRCIPK_pn-ti-codecs-omapl137 = "1"
SRCIPK_INSTALL_DIR_pn-ti-codecs-omapl137 = "codecs-omapl137_${PV}"
SRCIPK_PACKAGE_ARCH_pn-ti-codecs-omapl137 = "${MACHINE_ARCH}"

CREATE_SRCIPK_pn-ti-codecs-omapl138 = "1"
SRCIPK_INSTALL_DIR_pn-ti-codecs-omapl138 = "codecs-omapl138_${PV}"
SRCIPK_PACKAGE_ARCH_pn-ti-codecs-omapl138 = "${MACHINE_ARCH}"

CREATE_SRCIPK_pn-ti-cgt6x = "1"
SRCIPK_INSTALL_DIR_pn-ti-cgt6x = "dsp-devkit/cgt6x_${PV}"
SRCIPK_PACKAGE_ARCH_pn-ti-cgt6x = "${MACHINE_ARCH}"

CREATE_SRCIPK_pn-ti-cgt470 = "1"
SRCIPK_INSTALL_DIR_pn-ti-cgt470 = "media-controller-devkit/cgt470_${PV}"
SRCIPK_PACKAGE_ARCH_pn-ti-cgt470 = "${MACHINE_ARCH}"

CREATE_SRCIPK_pn-ti-dspbios = "1"
SRCIPK_INSTALL_DIR_pn-ti-dspbios = "dspbios_${PV}"
SRCIPK_PACKAGE_ARCH_pn-ti-dspbios = "${MACHINE_ARCH}"

CREATE_SRCIPK_pn-ti-sysbios = "1"
SRCIPK_INSTALL_DIR_pn-ti-sysbios = "component-sources/bios_${PV}${PVExtra}"
SRCIPK_PACKAGE_ARCH_pn-ti-sysbios = "${MACHINE_ARCH}"

CREATE_SRCIPK_pn-ti-biosutils = "1"
SRCIPK_INSTALL_DIR_pn-ti-biosutils = "biosutils_${PV}"
SRCIPK_PACKAGE_ARCH_pn-ti-biosutils = "${MACHINE_ARCH}"

CREATE_SRCIPK_pn-ti-dsplink = "1"
SRCIPK_INSTALL_DIR_pn-ti-dsplink = "dsplink_${PV}"
SRCIPK_PACKAGE_ARCH_pn-ti-dsplink = "${MACHINE_ARCH}"

CREATE_SRCIPK_pn-ti-syslink = "1"
SRCIPK_INSTALL_DIR_pn-ti-syslink = "component-sources/syslink_${PV}${PVExtra}"
SRCIPK_PACKAGE_ARCH_pn-ti-syslink = "${MACHINE_ARCH}"

CREATE_SRCIPK_pn-ti-edma3lld = "1"
SRCIPK_INSTALL_DIR_pn-ti-edma3lld = "component-sources/edma3lld_${PV}"
SRCIPK_PACKAGE_ARCH_pn-ti-edma3lld = "${MACHINE_ARCH}"

CREATE_SRCIPK_pn-ti-c6accel = "1"
SRCIPK_INSTALL_DIR_pn-ti-c6accel = "component-sources/c6accel_${PV}"
SRCIPK_PACKAGE_ARCH_pn-ti-c6accel = "${MACHINE_ARCH}"

CREATE_SRCIPK_pn-ti-biospsp = "1"
SRCIPK_INSTALL_DIR_pn-ti-biospsp = "biospsp_${PV}"
SRCIPK_PACKAGE_ARCH_pn-ti-biospsp = "${MACHINE_ARCH}"

CREATE_SRCIPK_pn-ti-audio-soc-example = "1"
SRCIPK_INSTALL_DIR_pn-ti-audio-soc-example = "audio-soc-example_${PV}"
SRCIPK_PACKAGE_ARCH_pn-ti-audio-soc-example = "${MACHINE_ARCH}"

CREATE_SRCIPK_pn-ti-c6run = "1"
SRCIPK_INSTALL_DIR_pn-ti-c6run = "component-sources/c6run_${PV}"
SRCIPK_PACKAGE_ARCH_pn-ti-c6run = "${MACHINE_ARCH}"

CREATE_SRCIPK_pn-ti-osal = "1"
SRCIPK_INSTALL_DIR_pn-ti-osal = "component-sources/osal_${PV}${PVExtra}"
SRCIPK_PACKAGE_ARCH_pn-ti-osal = "${MACHINE_ARCH}"

CREATE_SRCIPK_pn-ti-ipc = "1"
SRCIPK_INSTALL_DIR_pn-ti-ipc = "component-sources/ipc_${PV}"
SRCIPK_PACKAGE_ARCH_pn-ti-ipc = "${MACHINE_ARCH}"

CREATE_SRCIPK_pn-ti-dsp-benchmark = "1"
SRCIPK_INSTALL_DIR_pn-ti-dsp-benchmark = "example-applications/dsp-benchmark_${PV}"
SRCIPK_PACKAGE_ARCH_pn-ti-dsp-benchmark = "${MACHINE_ARCH}"

CREATE_SRCIPK_pn-gstreamer-ti = "1"
SRCIPK_INSTALL_DIR_pn-gstreamer-ti = "gstreamer-ti_${PV}"
SRCIPK_PACKAGE_ARCH_pn-gstreamer-ti = "${MACHINE_ARCH}"

CREATE_SRCIPK_pn-ti-omx = "1"
SRCIPK_INSTALL_DIR_pn-ti-omx = "component-sources/omx_${PV}"
SRCIPK_PACKAGE_ARCH_pn-ti-omx = "${MACHINE_ARCH}"

CREATE_SRCIPK_pn-ti-uia = "1"
SRCIPK_INSTALL_DIR_pn-ti-uia = "component-sources/uia_${PV}${PVExtra}"
SRCIPK_PACKAGE_ARCH_pn-ti-uia = "${MACHINE_ARCH}"

CREATE_SRCIPK_pn-ti-media-controller-utils = "1"
SRCIPK_INSTALL_DIR_pn-ti-media-controller-utils = "board-support/media-controller-utils_${PV}"
SRCIPK_PACKAGE_ARCH_pn-ti-media-controller-utils = "${MACHINE_ARCH}"

CREATE_SRCIPK_pn-ti-firmware-dm816x = "1"
SRCIPK_INSTALL_DIR_pn-ti-firmware-dm816x = "board-support/prebuilt-images/dm816x-firmware_${PV}"
SRCIPK_PACKAGE_ARCH_pn-ti-firmware-dm816x = "${MACHINE_ARCH}"

CREATE_SRCIPK_pn-ti-firmware-dm814x = "1"
SRCIPK_INSTALL_DIR_pn-ti-firmware-dm814x = "board-support/prebuilt-images/dm814x-firmware_${PV}"
SRCIPK_PACKAGE_ARCH_pn-ti-firmware-dm814x = "${MACHINE_ARCH}"

CREATE_SRCIPK_pn-ti-slog = "1"
SRCIPK_INSTALL_DIR_pn-ti-slog = "component-sources/slog_${PV}"
SRCIPK_PACKAGE_ARCH_pn-ti-slog = "${MACHINE_ARCH}"

CREATE_SRCIPK_pn-ti-c674x-aaclcdec = "1"
SRCIPK_INSTALL_DIR_pn-ti-c674x-aaclcdec = "component-sources/c674x-aaclcdec_${PV}${PVExtra}"
SRCIPK_PACKAGE_ARCH_pn-ti-c674x-aaclcdec = "${MACHINE_ARCH}"

CREATE_SRCIPK_pn-oe-layersetup = "1"
SRCIPK_INSTALL_DIR_pn-oe-layersetup = "bin/oe-layersetup"
```
