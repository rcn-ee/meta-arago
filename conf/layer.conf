## meta-arago-distro/conf/distro/include/branding-bleeding.inc
```bitbake
# Special "bleeding" branding for experimenting and testing unreleased components

require branding-core.inc

# Auto rev important packages to pick up latest
SRCREV:pn-linux-ti-staging = "${AUTOREV}"
SRCREV:pn-linux-ti-staging-rt = "${AUTOREV}"
SRCREV:pn-linux-ti-staging-systest = "${AUTOREV}"
SRCREV:pn-u-boot-ti-staging = "${AUTOREV}"
SRCREV:pn-ltp-ddt = "${AUTOREV}"
#SRCREV:pn-optee-os = "${AUTOREV}"
#SRCREV:pn-optee-client = "${AUTOREV}"
#SRCREV:pn-optee-test = "${AUTOREV}"
SRCREV:pn-arm-trusted-firmware = "${AUTOREV}"

# Point to the latest ti linux firmware
TI_LINUX_FW_SRCREV = "${AUTOREV}"

# Point to the latest ti k3 image gen
K3_IMAGE_GEN_SRCREV = "${AUTOREV}"

# Point to latest nightly metadata
#TI_RTOS_METADATA_URI = "git://git.ti.com/processor-sdk/coresdk_rtos_releases.git"
#TI_RTOS_METADATA_PROTOCOL = "git"
TI_RTOS_METADATA_SRCREV = "${AUTOREV}"
TI_RTOS_METADATA_BRANCH = "next"

# Switch to internal nightlies, force overriding incorrect metadata values
# and ensure parsing won't break w/o metadata file
CORESDK_RTOS_WEBLINK_NIGHTLY ?= "file://empty"
CORESDK_RTOS_WEBLINK:forcevariable = "${CORESDK_RTOS_WEBLINK_NIGHTLY}"
CORESDK_RTOS_FIRMWARE_URL:forcevariable = "${DEFAULT_FIRMWARE_URL}"

# Avoid use of old cached nightly file by using timed prefix
DATEH := "${@time.strftime('%Y%m%d%H',time.gmtime())}"
CORESDK_RTOS_FILE_PREFIX = "${DATEH}-"
CORESDK_RTOS_FILE_SUFFIX = ";downloadfilename=${CORESDK_RTOS_FILE_PREFIX}${DEFAULT_FIRMWARE_FILE}"

# Build and assemble TI-SDK, but don't package it
IMAGE_FSTYPES:pn-tisdk-core-bundle = ""
```

## meta-arago-distro/conf/distro/include/branding-core-next.inc
```bitbake
# Special "migration" branding for testing components that are to be updated in LTS migration

require branding-core.inc

PREFERRED_VERSION_linux-ti-staging = ""
PREFERRED_VERSION_linux-ti-staging-rt = ""
PREFERRED_VERSION_linux-ti-staging-systest = ""
PREFERRED_VERSION_u-boot-ti-staging = ""

# Auto rev important packages to pick up latest
SRCREV_pn-linux-ti-staging = "${AUTOREV}"
SRCREV_pn-linux-ti-staging-rt = "${AUTOREV}"
SRCREV_pn-linux-ti-staging-systest = "${AUTOREV}"
SRCREV_pn-u-boot-ti-staging = "${AUTOREV}"
```

## meta-arago-distro/conf/distro/include/branding-core.inc
```bitbake
# Set extra preferences based on the product branding (AM-SDK, MC-SDK, etc)
# Examples could be different PREFERRED_PROVIDER or PREFERRED_VERSION
# As well as some other configurable aspects or variables
# Please avoid creating multiple versions of the same brand, if possible
# The policy is for the "Core" brand to be the default,
# hence this file is mostly empty and used as a template

# Lower opencl-monitor priority for now
ALTERNATIVE_PRIORITY:pn-opencl-monitor = "1"
ALTERNATIVE_PRIORITY:pn-opencl-monitor-ipu = "1"

# Raise priority for sample IPC FW images
ALTERNATIVE_PRIORITY:pn-ti-ipc-rtos = "15"

# Remove mmip - DRM allocator, KMS sink, Wayland sink need porting to GST 1.18
MACHINE_FEATURES:remove = "mmip"
```

## meta-arago-distro/conf/distro/include/branding-glsdk.inc
```bitbake
# GLSDK branding configuration

# Use the SDK supported kernel and kernel version
PREFERRED_PROVIDER_virtual/kernel = "linux-ti-glsdk"

PREFERRED_PROVIDER_virtual/bootloader_omap-a15 = "u-boot-ti-staging"
PREFERRED_PROVIDER_u-boot_omap-a15 = "u-boot-ti-staging"

# Set the PREFERRED_VERSION of libdrm to the glsdk version for the 
# glsdk branded builds
PREFERRED_VERSION_libdrm = "2.4.41"
```

## meta-arago-distro/conf/distro/include/branding-ltsprep.inc
```bitbake
PREFERRED_VERSION_linux-ti-staging = "6.1%"
PREFERRED_VERSION_linux-ti-staging-rt = "6.1%"
PREFERRED_VERSION_linux-ti-staging-systest = "6.1%"
PREFERRED_VERSION_u-boot-ti-staging = "2023.04%"

# Remove mmip - DRM allocator, KMS sink, Wayland sink need porting to GST 1.18
MACHINE_FEATURES:remove = "mmip"

# GC320 support requires out-of-tree drivers not available in until LTS prep is
# complete. Disable for now.
MACHINE_FEATURES:remove = "gc320"
```

## meta-arago-distro/conf/distro/include/branding-mainline.inc
```bitbake
PREFERRED_PROVIDER_virtual/kernel = "linux-ti-mainline"
PREFERRED_PROVIDER_virtual/bootloader = "u-boot-ti-mainline"
PREFERRED_PROVIDER_u-boot = "u-boot-ti-mainline"
SRCREV_ti-upstream-tools:pn-linux-ti-mainline = "${AUTOREV}"

# GPU support requires out-of-tree SGX and RGX drivers not available in mainline
# fall back to software rendering
MACHINE_FEATURES:remove = "gpu"
PREFERRED_PROVIDER_virtual/gpudriver = ""
```

## meta-arago-distro/conf/distro/include/branding-mcsdk.inc
```bitbake
# MCSDK branding configuration

# Use the MCSDK supported versions
PREFERRED_VERSION_libnl = "3.2.24"

DISTRO_FEATURES += "x11"

# Java preferences.
PREFERRED_VERSION_icedtea7-native = "2.1.3"
PREFERRED_PROVIDER_openjdk-7-jre = "openjdk-7-jre"

PREFERRED_PROVIDER_virtual/java-initial = "cacao-initial"

PREFERRED_PROVIDER_virtual/java-native = "jamvm-native"
PREFERRED_PROVIDER_virtual/javac-native = "ecj-bootstrap-native"

PREFERRED_PROVIDER_jpeg-native = "jpeg-native"
PREFERRED_PROVIDER_glibc-gconv-iso8859-1 = "eglibc-locale"
```

## meta-arago-distro/conf/distro/include/branding-next.inc
```bitbake
PREFERRED_PROVIDER_virtual/kernel = "linux-ti-next"
PREFERRED_PROVIDER_virtual/bootloader = "u-boot-ti-mainline"
PREFERRED_PROVIDER_u-boot = "u-boot-ti-mainline"
SRCREV:pn-linux-ti-next = "${AUTOREV}"
SRCREV:pn-u-boot-ti-mainline = "${AUTOREV}"

# GPU support requires out-of-tree SGX and RGX drivers not available in next
# fall back to software rendering
MACHINE_FEATURES:remove = "gpu"
PREFERRED_PROVIDER_virtual/gpudriver = ""
```

## meta-arago-distro/conf/distro/include/branding-processor-sdk.inc
```bitbake
ARAGO_TISDK_IMAGE = "processor-sdk-linux-image"

# Set CMEM reserved memory region
RESERVE_CMEM = "${@bb.utils.contains('MACHINE_FEATURES','dsp','1','0',d)}"
CMEM_BASE_omap-a15 ?= "a0000000"
CMEM_SIZE_omap-a15 ?= "08000000"

# To create newlines in the message \n is used and the slash must be escaped
# to function properly

SRCIPK_GIT_COMMIT_MESSAGE = "\
Create local branch\\n\
\\n\
The below commit is used for this local branch and is the one used by\\n\
this sdk:\\n\
${SRCREV}."

SRCIPK_SHALLOW_GIT_COMMIT_MESSAGE ="${SRCIPK_GIT_COMMIT_MESSAGE}\\n\\n\
To reduce the size of the SDK installer only a portion of the git commit\\n\
history has been preserved. Also links to remote branches and tags do\\n\
not exist in this copy of the repository.\\n\
To fix this please run the unshallow-repositories.sh\\n\
script located in the sdk\'s bin directory\\n\
\\n\
The script may take several minutes but you will then have a full copy of\\n\
the git repository including its entire git history.\\n"

SRCIPK_CUSTOM_GIT_BRANCH_pn-linux-ti-staging = "processor-sdk-local"
SRCIPK_CUSTOM_GIT_MESSAGE_pn-linux-ti-staging = "${SRCIPK_SHALLOW_GIT_COMMIT_MESSAGE}"
SRCIPK_SHALLOW_CLONE_pn-linux-ti-staging = "true"
SRCIPK_SHALLOW_DEPTH_pn-linux-ti-staging = "400"

SRCIPK_CUSTOM_GIT_BRANCH_pn-u-boot-ti-staging = "processor-sdk-local"
SRCIPK_CUSTOM_GIT_MESSAGE_pn-u-boot-ti-staging = "${SRCIPK_GIT_COMMIT_MESSAGE}"

# Temporarily disable "mmip" machine feature for all SOCs while building
# latest code base, until it is fixed for gstreamer 1.12
MACHINE_FEATURES := "${@d.getVar('MACHINE_FEATURES', True).replace('mmip', '')}"

# Temporarily disable UBI images for K2 "server" rootfs due to size
IMAGE_FSTYPES_remove_pn-tisdk-server-rootfs-image = "ubi ubifs"
```

## meta-arago-distro/conf/distro/include/toolchain-arago.inc
```bitbake
# Select external binary prebuilt Arago toolchain
TCMODE = "external-arago"
TCLIBC = "external-arago-toolchain"

#DEFAULTTUNE = "armv7at-neon"

# Set some vars to help locate the toolchain automatically from PATH
TOOLCHAIN_SYS := "arm-arago-linux-gnueabi"
TOOLCHAIN_PREFIX := "${TOOLCHAIN_SYS}-"
```

## meta-arago-distro/conf/distro/include/toolchain-arm.inc
```bitbake
# Select external binary prebuilt Arm toolchain
TCMODE = "external-arm"
TCLIBC = "external-arm-toolchain"

EAT_TARGET_SYS_ARMV5 ?= "arm-linux-gnueabi"
EAT_TARGET_SYS_ARMV7 ?= "arm-linux-gnueabihf"
EAT_TARGET_SYS_ARMV8 ?= "aarch64-linux-gnu"

EAT_TARGET_SYS_arm = "${EAT_TARGET_SYS_ARMV5}"
EAT_TARGET_SYS_armv7a = "${EAT_TARGET_SYS_ARMV7}"
EAT_TARGET_SYS_aarch64 = "${EAT_TARGET_SYS_ARMV8}"

SECONDARY_TARGET_ARCH = ""
SECONDARY_TARGET_ARCH_k3 = "armv7a"

TARGET_VENDOR = ""

TOOLCHAIN_BASE ?= "/opt"
TOOLCHAIN_PATH_ARMV5 ?= "${TOOLCHAIN_BASE}/gcc-arm-8.2-ti2019.00-armv5-x86_64-${EAT_TARGET_SYS_ARMV5}"
TOOLCHAIN_PATH_ARMV7 ?= "${TOOLCHAIN_BASE}/gcc-arm-8.2-2019.01-x86_64-${EAT_TARGET_SYS_ARMV7}"
TOOLCHAIN_PATH_ARMV8 ?= "${TOOLCHAIN_BASE}/gcc-arm-8.2-2019.01-x86_64-${EAT_TARGET_SYS_ARMV8}"

DEF_TOOLCHAIN_PATH_arm = "${TOOLCHAIN_PATH_ARMV5}"
DEF_TOOLCHAIN_PATH_armv7a = "${TOOLCHAIN_PATH_ARMV7}"
DEF_TOOLCHAIN_PATH_aarch64 = "${TOOLCHAIN_PATH_ARMV8}"

TOOLCHAIN_PATH ?= "${DEF_TOOLCHAIN_PATH}"

TOOLCHAIN_SYS := "${EAT_TARGET_SYS}"
TOOLCHAIN_PREFIX := "${TOOLCHAIN_SYS}-"

PREFERRED_PROVIDER_virtual/${TARGET_PREFIX}gcc-intermediate = "external-arm-toolchain"

PREFERRED_PROVIDER_gcc-cross-canadian-${TRANSLATED_TARGET_ARCH} ?= "external-arm-sdk-toolchain"
PREFERRED_PROVIDER_binutils-cross-canadian-${TRANSLATED_TARGET_ARCH} ?= "external-arm-sdk-toolchain"
#PREFERRED_PROVIDER_gdb-cross-canadian-${TRANSLATED_TARGET_ARCH} = "external-arm-sdk-toolchain"

PREFERRED_PROVIDER_gcc-cross-canadian-${SECONDARY_TARGET_ARCH} ?= "external-arm-secondary-sdk-toolchain"
PREFERRED_PROVIDER_binutils-cross-canadian-${SECONDARY_TARGET_ARCH} ?= "external-arm-secondary-sdk-toolchain"

# Special case for gdb to be built as part of canadian-cross-sdk, instead of packaged from external toolchain
bindir_pn-gdb-cross-canadian-${TRANSLATED_TARGET_ARCH} = "${exec_prefix}/bin"
PREFERRED_PROVIDER_gdb-cross-canadian-${TRANSLATED_TARGET_ARCH} = "gdb-cross-canadian-${TRANSLATED_TARGET_ARCH}"

# Set up runtime preferences
PREFERRED_PROVIDER_libgcc = "external-arm-toolchain"
PREFERRED_PROVIDER_gcc-runtime = "external-arm-toolchain"

# Set Cross and SDK toolchain preferences
SDKGCCVERSION ?= "arm-8.2%"
SDKGDBVERSION ?= "8.2"
SDKBINUVERSION ?= "2.31%"
SDKGLIBCVERSION ?= "2.28%"
SDKLINUXLIBCVERSION ?= "4.14%"

PREFERRED_VERSION_gcc-crosssdk-${SDK_SYS} ?= "${SDKGCCVERSION}"
PREFERRED_VERSION_gcc-crosssdk-initial-${SDK_SYS} ?= "${SDKGCCVERSION}"
PREFERRED_VERSION_gdb-crosssdk-${SDK_SYS} ?= "${SDKGDBVERSION}"
PREFERRED_VERSION_gdb-cross-canadian-${TRANSLATED_TARGET_ARCH} ?= "${SDKGDBVERSION}"
PREFERRED_VERSION_binutils-crosssdk-${SDK_SYS} ?= "${SDKBINUVERSION}"

PREFERRED_VERSION_nativesdk-gcc-runtime ?= "${SDKGCCVERSION}"
PREFERRED_VERSION_nativesdk-libgcc ?= "${SDKGCCVERSION}"
PREFERRED_VERSION_nativesdk-libgcc-initial ?= "${SDKGCCVERSION}"
PREFERRED_VERSION_nativesdk-linux-libc-headers ?= "${SDKLINUXLIBCVERSION}"
PREFERRED_VERSION_nativesdk-glibc ?= "${SDKGLIBCVERSION}"
PREFERRED_VERSION_nativesdk-glibc-locale ?= "${SDKGLIBCVERSION}"
PREFERRED_VERSION_nativesdk-glibc-initial ?= "${SDKGLIBCVERSION}"

# Set target toolchain preferences to match Cross/SDK by default
# Can be overwritten globally, if needed
GCCVERSION ?= "arm-8.2%"
GDBVERSION ?= "8.2"
BINUVERSION ?= "2.31%"
GLIBCVERSION ?= "2.28%"

PREFERRED_VERSION_gcc ?= "${GCCVERSION}"
PREFERRED_VERSION_gdb ?= "${GDBVERSION}"
PREFERRED_VERSION_binutils ?= "${BINUVERSION}"
PREFERRED_VERSION_glibc ?= "${GLIBCVERSION}"
PREFERRED_VERSION_glibc-locale ?= "${GLIBCVERSION}"
PREFERRED_VERSION_glibc-initial ?= "${GLIBCVERSION}"

# Licenses set for main components of the toolchain:
# (g)libc is always LGPL version 2 (or later)
# gcc has switched from GPL version 2 (or later) to version 3 (or later) after 4.2.1,
#    see this announcement - http://gcc.gnu.org/ml/gcc-announce/2007/msg00003.html
# libgcc and libstdc++ always had exceptions to GPL called Runtime Library Exception, but
#    it was based on GPL version 2 (or later), until new GPL version 3 (or later) exception
#    was introduced on 27 Jan 2009 - http://gcc.gnu.org/ml/gcc-announce/2009/msg00000.html
#    and http://www.gnu.org/licenses/gcc-exception.html, which was several days after
#    gcc 4.3.3 was released - http://gcc.gnu.org/releases.html
# gdb/gdbserver version 6.6 was the last one under GPL version 2 (or later), according
#    to the release schedule - http://www.gnu.org/software/gdb/schedule/
# binutils version 2.17 was the last one under GPL version 2 (or later), according
#    to the published releases - http://ftp.gnu.org/gnu/binutils/

python external_arm_toolchain_license_handler () {
	if not isinstance(e, bb.event.ConfigParsed):
		return
	d = e.data
	ld = d.createCopy()
	ld.finalize()

	lc_libc = "LGPL-2.1"
	lc_gcc = ["GPL-3.0", "GPL-2.0"][eat_get_gcc_version(ld) <= "4.2.1"]
	lc_rle = ["GPL-3.0-with-GCC-exception", "GPL-2.0-with-GCC-exception"][eat_get_gcc_version(ld) <= "4.3.3"]
	lc_gdb = ["GPL-3.0", "GPL-2.0"][eat_get_gdb_version(ld) <= "6.6"]
#	lc_bfd = ["GPL-3.0", "GPL-2.0"][eat_get_bfd_version(ld) <= "2.17"]

	d.setVar('EAT_LIC_LIBC', lc_libc)
	d.setVar('EAT_LIC_GCC', lc_gcc)
	d.setVar('EAT_LIC_RLE', lc_rle)
	d.setVar('EAT_LIC_GDB', lc_gdb)
#	d.setVar('EAT_LIC_BFD', lc_bfd)

	d.setVar('EAT_LICENSE', "%s&%s&%s&%s" % (lc_libc, lc_gcc, lc_rle, lc_gdb))
}
addhandler external_arm_toolchain_license_handler
```

## meta-arago-distro/conf/distro/include/toolchain-external-linaro.inc
```bitbake
# Select external binary prebuilt Linaro toolchain
TCMODE = "external-linaro"
TCLIBC = "external-linaro-toolchain"

ELT_TARGET_SYS = "arm-linux-gnueabihf"
DEFAULTTUNE = "cortexa8thf-neon"
DEFAULTTUNE_omap-a15 = "cortexa15thf-neon"
DEFAULTTUNE_keystone = "cortexa15thf-neon"
DEFAULTTUNE_omap4 = "cortexa9thf-neon"

PREFERRED_PROVIDER_virtual/${TARGET_PREFIX}gcc-intermediate = "external-linaro-toolchain"

# Set some vars to help locate the toolchain automatically from PATH
TOOLCHAIN_SYS := "${ELT_TARGET_SYS}"
TOOLCHAIN_PREFIX := "${TOOLCHAIN_SYS}-"

PREFERRED_PROVIDER_gcc-cross-canadian-${TRANSLATED_TARGET_ARCH} ?= "external-linaro-sdk-toolchain"
PREFERRED_PROVIDER_binutils-cross-canadian-${TRANSLATED_TARGET_ARCH} ?= "external-linaro-sdk-toolchain"
#PREFERRED_PROVIDER_gdb-cross-canadian-${TRANSLATED_TARGET_ARCH} = "external-linaro-sdk-toolchain"

# Special case for gdb to be built as part of canadian-cross-sdk, instead of packaged from external toolchain
PREFERRED_PROVIDER_gdb-cross-canadian-${TRANSLATED_TARGET_ARCH} = "gdb-cross-canadian-${TRANSLATED_TARGET_ARCH}"

SDKGCCVERSION ?= "4.7%"
SDKBINUVERSION ?= "2.22%"
SDKEGLIBCVERSION ?= "2.16%"
SDKLINUXLIBCVERSION ?= "3.2"

PREFERRED_VERSION_gcc-crosssdk ?= "${SDKGCCVERSION}"
PREFERRED_VERSION_gcc-crosssdk-initial ?= "${SDKGCCVERSION}"
PREFERRED_VERSION_gcc-crosssdk-intermediate ?= "${SDKGCCVERSION}"
PREFERRED_VERSION_nativesdk-gcc-runtime ?= "${SDKGCCVERSION}"
PREFERRED_VERSION_nativesdk-libgcc ?= "${SDKGCCVERSION}"
PREFERRED_VERSION_binutils-crosssdk ?= "${SDKBINUVERSION}"
PREFERRED_VERSION_nativesdk-linux-libc-headers ?= "${SDKLINUXLIBCVERSION}"
PREFERRED_VERSION_nativesdk-eglibc ?= "${SDKEGLIBCVERSION}"
PREFERRED_VERSION_nativesdk-eglibc-initial ?= "${SDKEGLIBCVERSION}"
```

## meta-arago-distro/conf/distro/include/toolchain-external.inc
```bitbake
# Set some default toolchain location variables
TOOLCHAIN_PATH ??= "/usr/local/sdk"
TOOLCHAIN_SYSPATH = "${TOOLCHAIN_PATH}/${TOOLCHAIN_SYS}"
EXTERNAL_TOOLCHAIN = "${TOOLCHAIN_PATH}"
```
